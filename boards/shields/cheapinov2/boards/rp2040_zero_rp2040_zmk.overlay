/*
 * Copyright (c) 2022 The ZMK Contributors
 *
 * SPDX-License-Identifier: MIT
 */

/ {
    cheapino_scan: kscan0 {
        compatible = "zmk,kscan-gpio-charlieplex";

        gpios
            // Left side
            = <&gpio0 27 (GPIO_ACTIVE_HIGH | GPIO_PULL_DOWN)> // Pin 0: L-Row0 (GP27)
            , <&gpio0 28 (GPIO_ACTIVE_HIGH | GPIO_PULL_DOWN)> // Pin 1: L-Row1 (GP28)
            , <&gpio0 29 (GPIO_ACTIVE_HIGH | GPIO_PULL_DOWN)> // Pin 2: L-Row2 (GP29)
            , <&gpio0 14 (GPIO_ACTIVE_HIGH | GPIO_PULL_DOWN)> // Pin 3: L-Col0 (GP14)
            , <&gpio0 15 (GPIO_ACTIVE_HIGH | GPIO_PULL_DOWN)> // Pin 4: L-Col1 (GP15)
            , <&gpio0 26 (GPIO_ACTIVE_HIGH | GPIO_PULL_DOWN)> // Pin 5: L-Col2 (GP26)

            // Right side
            , <&gpio0 3 (GPIO_ACTIVE_HIGH | GPIO_PULL_DOWN)>  // Pin 6: R-Row0 (GP3)
            , <&gpio0 1 (GPIO_ACTIVE_HIGH | GPIO_PULL_DOWN)>  // Pin 7: R-Row1 (GP1)
            , <&gpio0 2 (GPIO_ACTIVE_HIGH | GPIO_PULL_DOWN)>  // Pin 8: R-Row2 (GP2)
            , <&gpio0 6 (GPIO_ACTIVE_HIGH | GPIO_PULL_DOWN)>  // Pin 9: R-Col0 (GP6)
            , <&gpio0 5 (GPIO_ACTIVE_HIGH | GPIO_PULL_DOWN)>  // Pin 10: R-Col1 (GP5)
            , <&gpio0 4 (GPIO_ACTIVE_HIGH | GPIO_PULL_DOWN)>  // Pin 11: R-Col2 (GP4)
            ;
    };
};
