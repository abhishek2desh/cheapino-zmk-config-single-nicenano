/*
 * Add CDC ACM UART node so CONFIG_ZMK_USB_LOGGING=y can be satisfied
 * on the nice!nano ZMK variant (nrf52840dongle already includes this).
 */

/ {
    chosen {
        zephyr,console = &cdc_acm_uart0;
    };
};

&zephyr_udc0 {
    cdc_acm_uart0: cdc_acm_uart0 {
        compatible = "zephyr,cdc-acm-uart";
    };
};
