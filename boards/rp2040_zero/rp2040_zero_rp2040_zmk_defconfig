## boards/rp2040_zero/rp2040_zero_rp2040_zmk_defconfig
```kconfig
# SPDX-License-Identifier: MIT

CONFIG_SYS_CLOCK_HW_CYCLES_PER_SEC=125000000

CONFIG_RESET=y
CONFIG_CLOCK_CONTROL=y
CONFIG_USE_DT_CODE_PARTITION=y
CONFIG_BUILD_OUTPUT_UF2=y

# USB HID
CONFIG_ZMK_USB=y

# Settings
CONFIG_MPU_ALLOW_FLASH_WRITE=y
CONFIG_NVS=y
CONFIG_SETTINGS_NVS=y
CONFIG_FLASH=y
CONFIG_FLASH_PAGE_LAYOUT=y
CONFIG_FLASH_MAP=y

# Bootloader support
CONFIG_RETAINED_MEM=y
CONFIG_RETENTION=y
CONFIG_RETENTION_BOOT_MODE=y
```

## boards/shields/cheapino_wireless/Kconfig.defconfig
```kconfig
# Copyright (c) 2024 The ZMK Contributors
# SPDX-License-Identifier: MIT

if SHIELD_CHEAPINO_WIRELESS_LEFT

config ZMK_KEYBOARD_NAME
    default "Cheapino WL"

config ZMK_SPLIT
    default y

endif # SHIELD_CHEAPINO_WIRELESS_LEFT

if SHIELD_CHEAPINO_WIRELESS_RIGHT

config ZMK_SPLIT
    default y

endif # SHIELD_CHEAPINO_WIRELESS_RIGHT

if SHIELD_CHEAPINO_WIRELESS_DONGLE

config ZMK_KEYBOARD_NAME
    default "Cheapino WL"

config ZMK_SPLIT
    default y

config ZMK_SPLIT_ROLE_CENTRAL
    default y

config ZMK_SPLIT_BLE_CENTRAL_PERIPHERALS
    default 2

config BT_MAX_CONN
    default 7

config BT_MAX_PAIRED
    default 7

endif # SHIELD_CHEAPINO_WIRELESS_DONGLE
```

## boards/shields/cheapino_wireless/Kconfig.shield
```kconfig
# Copyright (c) 2024 The ZMK Contributors
# SPDX-License-Identifier: MIT

config SHIELD_CHEAPINO_WIRELESS_LEFT
    def_bool $(shields_list_contains,cheapino_wireless_left)

config SHIELD_CHEAPINO_WIRELESS_RIGHT
    def_bool $(shields_list_contains,cheapino_wireless_right)

config SHIELD_CHEAPINO_WIRELESS_DONGLE
    def_bool $(shields_list_contains,cheapino_wireless_dongle)
```

## boards/shields/cheapinov2_rp2040zero/Kconfig.defconfig
```kconfig
# Copyright (c) 2022 The ZMK Contributors
# SPDX-License-Identifier: MIT

if SHIELD_CHEAPINOV2_RP2040ZERO

config ZMK_KEYBOARD_NAME
    default "Cheapino v2"

config ZMK_MOUSE
    default y

endif # SHIELD_CHEAPINOV2_RP2040ZERO
```

## boards/shields/cheapinov2_rp2040zero/Kconfig.shield
```kconfig
# Copyright (c) 2022 The ZMK Contributors
# SPDX-License-Identifier: MIT

config SHIELD_CHEAPINOV2_RP2040ZERO
    def_bool $(shields_list_contains,cheapinov2_rp2040zero)
```
